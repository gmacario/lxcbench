## meta-lxcbench/conf/layer.conf
```bitbake
# Adapted from meta-mentor/conf/layer.conf

BBPATH .= ":${LAYERDIR}"
BBFILES += "${LAYERDIR}/recipes-phoronix/*/*.bb \
            ${LAYERDIR}/recipes-phoronix/*/*.bbappend"
BBFILES += "${LAYERDIR}/recipes-misc/*/*.bb \
            ${LAYERDIR}/recipes-misc/*/*.bbappend"
BBFILE_COLLECTIONS += "lxcbench"
BBFILE_PRIORITY_lxcbench = "10"
BBFILE_PATTERN_lxcbench = "^${LAYERDIR}/"

BB_DANGLINGAPPENDS_WARNONLY = "1"
```
